&spi1 {
	#address-cells = <1>;
	#size-cells = <0>;
	status = "okay";
	himax_ts@0 {
		compatible = "tct,lushan12_hx83121a_spi";
		reg = <0>;
		spi-max-frequency = <10000000>;
		spi-cpha;
		interrupt-parent = <&pio>;
		himax,panel-coords = <0 1600 0 2560>;
		himax,display-coords = <0 1600 0 2560>;
		himax,irq-gpio = <&pio 21 0x2008>;
		himax,rst-gpio = <&pio 14 0x00>;
		report_type = <1>;
   };
};

