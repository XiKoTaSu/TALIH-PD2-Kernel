## drivers/input/touchscreen/lushan14_nt36532_spi_touch/Kconfig
```kconfig
#
# Novatek NT36xxx touchscreen driver configuration
#
config TOUCHSCREEN_LUSHAN14_NT36532_SPI
	bool "Novatek NT36xxx host download SPI driver"
	default y
	help
	  Say Y here if you have a Novatek NT36xxx no flash touchscreen connected
	  to your system by SPI bus.

	  If unsure, say N.
```
